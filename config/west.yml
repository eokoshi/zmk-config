## config/west.yml
```yaml
manifest:
  remotes:
    - name: zmkfirmware
      url-base: https://github.com/zmkfirmware
    - name: eokoshi
      url-base: https://github.com/eokoshi
  projects:
    - name: zmk
      remote: zmkfirmware
      revision: 641514a97db345f499dd50b0360e594270f008fe # main (2026-08-31)
      import: app/west.yml

    # ZMK modules
    - name: zmk-keyboards-eyelash_corne
      remote: eokoshi
      revision: b84c6166fb4642023de7d253b837eed11e4139e6 # main (2026-09-07)
      path: modules/zmk/eyelash_corne

    # Avoid downloading GBs of unused Zephyr modules. Remove this section to
    # restore the default (needed for less common hardware).
    - name: zephyr
      remote: zmkfirmware
      revision: 10ba6d0cb38bc3d258775d27982f707599320085 # v4.1.0+zmk-fixes (2026-08-18)
      clone-depth: 1
      import:
        name-allowlist:
          - cmsis
          - hal_nordic
          - hal_rpi_pico
          - hal_stm32 # imported independently by ZMK
          - lvgl # imported independently by ZMK
          - mbedtls
          - tinycrypt

    # --- imported projects pinned by pin-west; do not edit ---
    - name: cmsis # via zephyr (west.yml)
      url: https://github.com/zephyrproject-rtos/cmsis
      revision: d1b8b20b6278615b00e136374540eb1c00dcabe7
      path: modules/hal/cmsis
      groups: [hal]
    - name: hal_nordic # via zephyr (west.yml)
      url: https://github.com/zephyrproject-rtos/hal_nordic
      revision: 37ca068d7b013fb65a2acc9306bffa48a3e72839
      path: modules/hal/nordic
      groups: [hal]
    - name: hal_rpi_pico # via zephyr (west.yml)
      url: https://github.com/zephyrproject-rtos/hal_rpi_pico
      revision: 7b57b24588797e6e7bf18b6bda168e6b96374264
      path: modules/hal/rpi_pico
      groups: [hal]
    - name: hal_stm32 # via zmk (app/west.yml)
      url: https://github.com/zmkfirmware/hal_stm32
      revision: 4fcc3a3f32abe1c4cb76d9d1cef967728dd03908
      path: modules/hal/stm32
      groups: [hal]
    - name: lvgl # via zmk (app/west.yml)
      url: https://github.com/zmkfirmware/lvgl
      revision: f1db87ee98f1810328a8419572fa42a3b5f352ae
      path: modules/lib/gui/lvgl
    - name: mbedtls # via zephyr (west.yml)
      url: https://github.com/zephyrproject-rtos/mbedtls
      revision: 4952e1328529ee549d412b498ea71c54f30aa3b1
      path: modules/crypto/mbedtls
      groups: [crypto]
    - name: tinycrypt # via zephyr (west.yml)
      url: https://github.com/zephyrproject-rtos/tinycrypt
      revision: 1012a3ebee18c15ede5efc8332ee2fc37817670f
      path: modules/crypto/tinycrypt
      groups: [crypto]
    - name: zmk-studio-messages # via zmk (app/west.yml)
      url: https://github.com/zmkfirmware/zmk-studio-messages
      revision: 6cb4c283e76209d59c45fbcb218800cd19e9339d
      path: modules/msgs/zmk-studio-messages
    # --- end of imported projects ---

  self:
    path: config
```
